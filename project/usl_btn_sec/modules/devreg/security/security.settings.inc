#ifndef __INC_SECURITY_SETTINGS_INC__
#define __INC_SECURITY_SETTINGS_INC__

//*****************************************************************************
// DEFAULT SETTINGS
//*****************************************************************************

#define SECURITY_FLASH_HWREV_1 1 // Pre 11/1/2013 - before this was introduced
#define SECURITY_FLASH_HWREV_2 2 // Added MXIC SFDP support
#define SECURITY_FLASH_HWREV_3 3 // Added MXIC MX25L25635F support
#define SECURITY_FLASH_HWREV_4 4 // Added MXIC MX25U1635F support
#define SECURITY_FLASH_HWREV_5 5 // Added MXIC MX25L8008 support (1M MXIC)
#define SECURITY_FLASH_HWREV_6 6 // Added MXIC MX25L8008E support (1M MXIC)
#define SECURITY_FLASH_HWREV_7 7 // Added MXIC MX25U25635F support (32M MXIC)
#define SECURITY_FLASH_HWREV_8 8 // Added MXIC MX25U6435F support (8M MXIC)
#define SECURITY_FLASH_HWREV_MAX SECURITY_FLASH_HWREV_8

#if !defined(SECURITY_ENABLE_RETRIES)
	#define SECURITY_ENABLE_RETRIES 1
#endif // #if !defined(SECURITY_ENABLE_SIGNAL_HANDLER)

#if !defined(SECURITY_RETRY_DELAY_S)
	#define SECURITY_RETRY_DELAY_S 1
#endif // #if !defined(SECURITY_RETRY_DELAY_S)

#if !defined(SECURITY_ENABLE_SIGNAL_HANDLER)
	#define SECURITY_ENABLE_SIGNAL_HANDLER 0
#endif // #if !defined(SECURITY_ENABLE_SIGNAL_HANDLER)

#if !defined(SECURITY_ENABLE_DEBUG_OUTPUT)
	#define SECURITY_ENABLE_DEBUG_OUTPUT 0
#endif // #if !defined(SECURITY_ENABLE_DEBUG_OUTPUT)

#if !defined(SECURITY_ENABLE_FD_LEAK_DEBUG)
	#define SECURITY_ENABLE_FD_LEAK_DEBUG 0
#endif // #if !defined(SECURITY_ENABLE_FD_LEAK_DEBUG)

#if !defined(SECURITY_ENABLE_DIAGNOSTIC_DUMPS)
	#define SECURITY_ENABLE_DIAGNOSTIC_DUMPS 0
#endif // #if !defined(SECURITY_ENABLE_DIAGNOSTIC_DUMPS)

#if !defined(SECURITY_ENABLE_DEBUG_PRINT_FAILURE_BITS)
	#define SECURITY_ENABLE_DEBUG_PRINT_FAILURE_BITS 0
#endif // #if !defined(SECURITY_ENABLE_DEBUG_PRINT_FAILURE_BITS)

#if !defined(SECURITY_ENABLE_DEBUG_PRINT_FULL_FAILURE_BITSETS)
	#define SECURITY_ENABLE_DEBUG_PRINT_FULL_FAILURE_BITSETS 0
#endif // #if !defined(SECURITY_ENABLE_DEBUG_PRINT_FULL_FAILURE_BITSETS)

#if !defined(SECURITY_ENABLE_INLINE_HINTS)
	#define SECURITY_ENABLE_INLINE_HINTS 0
#endif // #if !defined(SECURITY_NO_INLINE_HINTS)

#if !defined(SECURITY_ENABLE_CRASHING)
	#define SECURITY_ENABLE_CRASHING 0
#endif // #if !defined(SECURITY_ENABLE_CRASHING)

#if !defined(SECURITY_USE_STATICS_FOR_LOCALS)
	#define SECURITY_USE_STATICS_FOR_LOCALS 1
#endif // #ifndef SECURITY_USE_STATICS_FOR_LOCALS

#if !defined(SECURITY_ENABLE_FORCED_INLINE)
	#define SECURITY_ENABLE_FORCED_INLINE 0
#endif // #if !defined(SECURITY_ENABLE_FORCED_INLINE)

#if !defined(SECURITY_ENABLE_UNUSED_FUNCTION_WARNINGS)
	#define SECURITY_ENABLE_UNUSED_FUNCTION_WARNINGS 0
#endif // #if !defined(SECURITY_ENABLE_UNUSED_FUNCTION_WARNINGS)

#if !defined(SECURITY_ENABLE_RSA_KEY_LOAD_SHORTCUT)
	#define SECURITY_ENABLE_RSA_KEY_LOAD_SHORTCUT 1
#endif // #if !defined(SECURITY_ENABLE_RSA_KEY_LOAD_SHORTCUT)

#include "security.settings.target.GM81xx.inc"
#include "security.settings.target.ARxxxx.inc"
#include "security.settings.target.RTL838x.inc"
#include "security.settings.target.AM18xx.inc"
#include "security.settings.target.CN50xx.inc"
#include "security.settings.target.MT7621.inc"
#include "security.settings.target.MT7623.inc"
#include "security.settings.target.AM3xxx.inc"
#include "security.settings.target.A5S.inc"
#include "security.settings.target.S2.inc"
#include "security.settings.target.S2L.inc"
#include "security.settings.target.S2LM.inc"
#include "security.settings.target.S5L.inc"
#include "security.settings.target.S5LM.inc"
#include "security.settings.target.BCM4706.inc"
#include "security.settings.target.QCA851x.inc"
#include "security.settings.target.BCM5334x.inc"
#include "security.settings.target.BCM5341x.inc"
#include "security.settings.target.VSC7514.inc"
#include "security.settings.target.BCM5616x.inc"
#include "security.settings.target.NVRx64.inc"
#include "security.settings.target.sim.inc"
#include "security.settings.target.BCM111xx.inc"
#include "security.settings.target.MT8117.inc"
#include "security.settings.target.STM32F30x.inc"
#include "security.settings.target.IPQ40xx.inc"
#include "security.settings.target.IPQ806x.inc"
#include "security.settings.target.APQ8053.inc"
#include "security.settings.target.AL324.inc"
#include "security.settings.target.IPQ807x.inc"
#include "security.settings.target.EFR32xG13.inc"
#include "security.settings.target.ST50H.inc"

#ifndef SECURITY_LOW_MEMORY
#define SECURITY_LOW_MEMORY 0
#endif //  #ifndef SECURITY_LOW_MEMORY

#ifndef SECURITY_HAVE_PROPRIETARY_SPI_CONTROLLER
    #define SECURITY_HAVE_PROPRIETARY_SPI_CONTROLLER 0
#endif // #ifndef SECURITY_HAVE_PROPRIETARY_SPI_CONTROLLER

#ifndef SECURITY_HAVE_DIRECT_BITBANG_SPI_FLASH_HARDWARE
	#define SECURITY_HAVE_DIRECT_BITBANG_SPI_FLASH_HARDWARE 0
#endif // #ifndef SECURITY_HAVE_DIRECT_BITBANG_SPI_FLASH_HARDWARE

#if !defined(SECURITY_FLASH_HWREV)
	#define SECURITY_FLASH_HWREV SECURITY_FLASH_HWREV_1
#endif // #if !defined(SECURITY_FLASH_HWREV)

#ifndef SECURITY_HAVE_SPI_FLASH_HARDWARE
	#define SECURITY_HAVE_SPI_FLASH_HARDWARE SECURITY_HAVE_DIRECT_BITBANG_SPI_FLASH_HARDWARE
#endif // #ifndef SECURITY_HAVE_SPI_FLASH_HARDWARE

#ifndef SECURITY_HAVE_LINUX_SPI_DRIVER
        #define SECURITY_HAVE_LINUX_SPI_DRIVER 0
#endif // #ifndef SECURITY_HAVE_LINUX_SPI_DRIVER

#if SECURITY_HAVE_LINUX_SPI_DRIVER && !SECURITY_HAVE_SPI_FLASH_HARDWARE
        #error SECURITY_HAVE_LINUX_SPI_DRIVER && !SECURITY_HAVE_SPI_FLASH_HARDWARE
#endif // #if SECURITY_HAVE_LINUX_SPI_DRIVER && !SECURITY_HAVE_SPI_FLASH_HARDWARE

#if SECURITY_HAVE_DIRECT_BITBANG_SPI_FLASH_HARDWARE && !SECURITY_HAVE_SPI_FLASH_HARDWARE
        #error SECURITY_HAVE_DIRECT_BITBANG_SPI_FLASH_HARDWARE && !SECURITY_HAVE_SPI_FLASH_HARDWARE
#endif // #if SECURITY_HAVE_DIRECT_BITBANG_SPI_FLASH_HARDWARE && !SECURITY_HAVE_SPI_FLASH_HARDWARE

#ifndef SECURITY_IS_TARGET_BUILD
    #ifdef HELPER_BUILD
        #define SECURITY_IS_TARGET_BUILD 1
    #else
    	#define SECURITY_IS_TARGET_BUILD 0
    #endif
#endif // #ifndef SECURITY_IS_TARGET_BUILD

#ifndef SECURITY_READ_CONFIG_USES_DIRECT_MEMORY_ACCESS
	#define SECURITY_READ_CONFIG_USES_DIRECT_MEMORY_ACCESS 0
#endif // #ifndef SECURITY_READ_CONFIG_USES_DIRECT_MEMORY_ACCESS

#ifndef SECURITY_READ_CONFIG_USES_READ_MEM
	#define SECURITY_READ_CONFIG_USES_READ_MEM 0
#endif // #ifndef SECURITY_READ_CONFIG_USES_READ_MEM

#ifndef SECURITY_READ_CONFIG_USES_MMAP
	#define SECURITY_READ_CONFIG_USES_MMAP 0
#endif // #ifndef SECURITY_READ_CONFIG_USES_MMAP

#ifndef SECURITY_READ_CONFIG_USES_READ_FLASH
	#define SECURITY_READ_CONFIG_USES_READ_FLASH 0
#endif // #ifndef SECURITY_READ_CONFIG_USES_READ_FLASH

#ifndef SECURITY_ENABLE_GRANDFATHER_AR7240_AR7241
#if (defined(SECURITY_ENABLE_SIMULATION) && SECURITY_ENABLE_SIMULATION) || (defined(UBNT_MIPS_ARxxxx) && UBNT_MIPS_ARxxxx)
	#define SECURITY_ENABLE_GRANDFATHER_AR7240_AR7241 1
#else
    #define SECURITY_ENABLE_GRANDFATHER_AR7240_AR7241 0
#endif
#endif // #ifndef SECURITY_ENABLE_GRANDFATHER_AR7240_AR7241

#ifndef SECURITY_ENABLE_TMPTAG
	#define SECURITY_ENABLE_TMPTAG 1
#endif // #ifndef SECURITY_ENABLE_TMPTAG

#ifndef SECURITY_ENABLE_LOCKOUT
	#define SECURITY_ENABLE_LOCKOUT 0
#endif // #ifndef SECURITY_ENABLE_LOCKOUT

#ifndef SECURITY_ENABLE_TAG_ETC_VERSION
	#define SECURITY_ENABLE_TAG_ETC_VERSION 1
#endif // #ifndef SECURITY_ENABLE_TAG_ETC_VERSION

#ifndef SECURITY_ENABLE_TAG_ETC_COUNTERFEIT
	#define SECURITY_ENABLE_TAG_ETC_COUNTERFEIT 1
#endif // #ifndef SECURITY_ENABLE_TAG_ETC_COUNTERFEIT

//#ifndef __OPTIMIZE__
//	#error The security macros should only be compiled with at least -O1.
//#endif // #ifndef __OPTIMIZE__

#ifndef SECURITY_ENABLE_SET_HOSTNAME_TO_COUNTERFEIT
#define SECURITY_ENABLE_SET_HOSTNAME_TO_COUNTERFEIT 1
#endif // #ifndef SECURITY_ENABLE_SET_HOSTNAME_TO_COUNTERFEIT

#ifndef SECURITY_ENABLE_SET_DOMAINNAME_TO_COUNTERFEIT
	#define SECURITY_ENABLE_SET_DOMAINNAME_TO_COUNTERFEIT 1
#endif // #ifndef SECURITY_ENABLE_SET_DOMAINNAME_TO_COUNTERFEIT

#ifndef SECURITY_ENABLE_SET_PRINTK_RATELIMIT_TO_666
	#define SECURITY_ENABLE_SET_PRINTK_RATELIMIT_TO_666 1
#endif // #ifndef SECURITY_ENABLE_SET_PRINTK_RATELIMIT_TO_666

#ifndef SECURITY_ENABLE_DISABLE_IPv4_FORWARDING
	#define SECURITY_ENABLE_DISABLE_IPv4_FORWARDING 1
#endif // #ifndef SECURITY_ENABLE_DISABLE_IPv4_FORWARDING

#ifndef SECURITY_ENABLE_MANGLE
	#define SECURITY_ENABLE_MANGLE 1
#endif // #ifndef SECURITY_ENABLE_MANGLE

#ifndef SECURITY_ENABLE_FS_LOCK
	#define SECURITY_ENABLE_FS_LOCK 1
#endif // #ifndef SECURITY_ENABLE_FS_LOCK

#ifndef SECURITY_ENABLE_ATH_OUI_MATCHES_EEPROM_WITH_CORRUPTED_CRCS
    #define SECURITY_ENABLE_ATH_OUI_MATCHES_EEPROM_WITH_CORRUPTED_CRCS 1
#endif

#ifndef SECURITY_ENABLE_MAC_ADDRESS_SUPPORT
    #define SECURITY_ENABLE_MAC_ADDRESS_SUPPORT 1
#endif

#ifndef SECURITY_ENABLE_ESN_SIGNATURE_CHECKS
    #define SECURITY_ENABLE_ESN_SIGNATURE_CHECKS 1
#endif

#ifndef SECURITY_ENABLE_FILE_IO_SUPPORT
    #define SECURITY_ENABLE_FILE_IO_SUPPORT 1
#endif

#if SECURITY_ENABLE_FILE_IO_SUPPORT
    #ifndef SECURITY_ENABLE_INI_SUPPORT
        #define SECURITY_ENABLE_INI_SUPPORT 1
    #endif
    #ifndef SECURITY_ENABLE_TOUGHER_INI_VALIDATION
        #define SECURITY_ENABLE_TOUGHER_INI_VALIDATION 1
    #endif
    #ifndef SECURITY_WRITE_CONFIG_USES_FILE
        #define SECURITY_WRITE_CONFIG_USES_FILE 1
    #endif // #if !defined(SECURITY_WRITE_CONFIG_USES_FILE)
#else // #if SECURITY_ENABLE_FILE_IO_SUPPORT
    #if defined(SECURITY_ENABLE_INI_SUPPORT) && SECURITY_ENABLE_INI_SUPPORT
        #error No SECURITY_ENABLE_INI_SUPPORT without SECURITY_ENABLE_FILE_IO_SUPPORT
    #else
        #define SECURITY_ENABLE_INI_SUPPORT 0
        #if defined(SECURITY_ENABLE_TOUGHER_INI_VALIDATION) && SECURITY_ENABLE_TOUGHER_INI_VALIDATION
            #error No SECURITY_ENABLE_TOUGHER_INI_VALIDATION without SECURITY_ENABLE_FILE_IO_SUPPORT and SECURITY_ENABLE_INI_SUPPORT
        #else
            #define SECURITY_ENABLE_TOUGHER_INI_VALIDATION 0
        #endif
    #endif // #ifdef SECURITY_ENABLE_INI_SUPPORT
    #if defined(SECURITY_WRITE_CONFIG_USES_FILE) && SECURITY_WRITE_CONFIG_USES_FILE
        #error No SECURITY_WRITE_CONFIG_USES_FILE without SECURITY_ENABLE_FILE_IO_SUPPORT
    #else
        #define SECURITY_WRITE_CONFIG_USES_FILE 0
    #endif // #ifdef SECURITY_ENABLE_INI_SUPPORT
#endif // #if SECURITY_ENABLE_FILE_IO_SUPPORT

#ifndef SECURITY_ENABLE_SET_VAR_OBFUSCATION
    #define SECURITY_ENABLE_SET_VAR_OBFUSCATION 1
#endif

#ifndef SECURITY_INCLUDE_WRITE_MEM
    #define SECURITY_INCLUDE_WRITE_MEM 0
#endif

#ifndef SECURITY_INCLUDE_FLASH_PARTITION_SUPPORT
    #define SECURITY_INCLUDE_FLASH_PARTITION_SUPPORT 1
#endif

#ifndef SECURITY_ENABLE_ATH_OUI_MATCHES_EEPROM_WITH_CORRUPTED_CRCS
    #define SECURITY_ENABLE_ATH_OUI_MATCHES_EEPROM_WITH_CORRUPTED_CRCS 1
#endif

//*****************************************************************************
// SANITY CHECKS
//*****************************************************************************

#if !SECURITY_ENABLE_INLINE_HINTS && SECURITY_ENABLE_FORCED_INLINE
	#error SECURITY_ENABLE_FORCED_INLINE can not be used without SECURITY_ENABLE_INLINE_HINTS
#endif // #if !SECURITY_ENABLE_INLINE_HINTS && SECURITY_ENABLE_FORCED_INLINE

#if SECURITY_ENABLE_SIGNAL_HANDLER && SECURITY_ENABLE_FORCED_INLINE
	#error SECURITY_ENABLE_FORCED_INLINE can not be used with SECURITY_ENABLE_SIGNAL_HANDLER
#endif // #if SECURITY_ENABLE_SIGNAL_HANDLER && SECURITY_ENABLE_FORCED_INLINE

#if SECURITY_ENABLE_DIAGNOSTIC_DUMPS && !SECURITY_ENABLE_DEBUG_OUTPUT
	#error SECURITY_ENABLE_DIAGNOSTIC_DUMPS can not be used without SECURITY_ENABLE_DEBUG_OUTPUT
#endif // #if SECURITY_ENABLE_DIAGNOSTIC_DUMPS && !SECURITY_ENABLE_DEBUG_OUTPUT

#if SECURITY_ENABLE_FD_LEAK_DEBUG && !SECURITY_ENABLE_DEBUG_OUTPUT
	#error SECURITY_ENABLE_FD_LEAK_DEBUG can not be used without SECURITY_ENABLE_DEBUG_OUTPUT
#endif // #if SECURITY_ENABLE_FD_LEAK_DEBUG && !SECURITY_ENABLE_DEBUG_OUTPUT

#endif // #ifndef __INC_SECURITY_SETTINGS_INC__
